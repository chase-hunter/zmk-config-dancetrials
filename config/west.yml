## config/west.yml
```yaml
manifest:
  remotes:
    - name: chase-hunter
      url-base: https://github.com/chase-hunter
    - name: zmkfirmware
      url-base: https://github.com/zmkfirmware
    #- name: m165437 #nice-view-gem
    #  url-base: https://github.com/M165437 #nice-view-gem
  projects:
    - name: zmk
      remote: zmkfirmware
      revision: v0.3
      import: app/west.yml
    - name: nice-shield-p #pig
      remote: chase-hunter #pig
      revision: main #pig
    #- name: nice-view-lambda #chase-view
    #  remote: chase-hunter #chase-view
    #  revision: main #chase-view
    #- name: nice-view-gem #nice-view-gem
    #  remote: m165437 #nice-view-gem
    #  revision: main #nice-view-gem
  self:
    path: config
```
